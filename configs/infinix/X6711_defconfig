## configs/infinix/X6711_defconfig
```kconfig
CONFIG_APP_ADDRESS=0x4822ECB8
CONFIG_BOOTLOADER_BASE=0x48200000
CONFIG_BOOTLOADER_SIZE=0x11BF58
CONFIG_BOOTMODE_ADDRESS=0x4831E598
CONFIG_CERT_BYPASS=y
CONFIG_DPRINTF_ADDRESS=0x4823CC80
CONFIG_ENVIRONMENT_SUPPORT=y
CONFIG_FASTBOOT_FAIL_ADDRESS=0x4822F6EC
CONFIG_FASTBOOT_INFO_ADDRESS=0x4822F644
CONFIG_FASTBOOT_OKAY_ADDRESS=0x4822F8C8
CONFIG_FASTBOOT_PUBLISH_ADDRESS=0x4822F2D0
CONFIG_FASTBOOT_REGISTER_ADDRESS=0x4822F294
CONFIG_FREE_ADDRESS=0x4823D0B4
CONFIG_GET_ENV_ADDRESS=0x48259AF8
CONFIG_INFINIX_X6711=y
CONFIG_INIT_STORAGE_ADDRESS=0x482025DC
CONFIG_INIT_STORAGE_CALLER=0x4820271A
CONFIG_LK_LOG_STORE_ADDRESS=0x48252C68
CONFIG_MALLOC_ADDRESS=0x4823DA78
CONFIG_MEDIATEK_MT6833=y
CONFIG_MTK_DETECT_KEY_ADDRESS=0x4820478C
CONFIG_PARTITION_GET_SIZE_BY_NAME_ADDRESS=0x482597A4
CONFIG_PARTITION_READ_ADDRESS=0x4825AA54
CONFIG_PLATFORM_INIT_ADDRESS=0x482026EC
CONFIG_PLATFORM_INIT_CALLER=0x4822AB32
CONFIG_SET_ENV_ADDRESS=0x48259D10
CONFIG_SPOOF_SUPPORT=y
CONFIG_STAGE1_SUPPORT=y
CONFIG_THREAD_CREATE_ADDRESS=0x4822B378
CONFIG_VIDEO_PRINTF_ADDRESS=0x4823C85C
```
